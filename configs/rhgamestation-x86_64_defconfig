## configs/rhgamestation-x86_64_defconfig
```kconfig
BR2_x86_64=y
BR2_ROOTFS_POST_IMAGE_SCRIPT="board/rhgamestation/copy-rhgamestation-archives.sh"
BR2_TARGET_GRUB2=y
BR2_TARGET_GRUB2_X86_64_EFI=y
```
